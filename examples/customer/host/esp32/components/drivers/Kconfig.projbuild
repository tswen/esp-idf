## examples/customer/host/esp32/components/drivers/Kconfig.projbuild
```kconfig
menu "Driver platform Configuration"

choice TRANSMIT_PERIPHERAL
    prompt "Transmit peripheral"
    default TRANSMIT_USE_SDSPI
    help
        Select transmit peripheral(SDIO or SPI or SDSPI)

config TRANSMIT_USE_SPI
    bool "Using SPI"
config TRANSMIT_USE_SDIO
    bool "Using SDIO(Only for ESP32)"
config TRANSMIT_USE_SDSPI
    bool "Using SDSPI(Only for ESP32)"
endchoice

choice TARGET_PLATFORM
    prompt "Taget slave platform"
    default SLAVE_ESP32_SERIES 
    help
        Select which target is used (ESP8266 or ESP32 series(ESP32_C3 or ESP32_S2)).

config SLAVE_ESP32_SERIES
    depends on TRANSMIT_USE_SPI
    bool "ESP32 series(ESP32-S2/ESP32-C3)"
config SLAVE_ESP8266
    depends on TRANSMIT_USE_SPI
    bool "ESP8266"
config SLAVE_ESP32
    depends on TRANSMIT_USE_SDIO
    bool "ESP32"
endchoice

choice SDIO_TRANSMIT
    prompt "SDIO transmit mode"
    depends on TRANSMIT_USE_SDIO
    default SDIO_ONE_BIT_MODE

config SDIO_ONE_BIT_MODE
    bool "1-bit mode"
    help
        The MCU can transmit data through 1-line SD protocol.
config SDIO_FOUR_BIT_MODE
    bool "4-bit mode"
    help
        The MCU can transmit data through 4-line SD protocol. 
endchoice

choice SPI_TRANSMIT
    prompt "communicate way for SPI transmit"
    depends on TRANSMIT_USE_SPI
    default SPI_SINGLE_MODE

config SPI_SINGLE_MODE
    bool "Standard SPI"
    help
        The MCU can transmit data through MOSI or MISO line.
config SPI_DUAL_MODE
    bool "Dual SPI"
    help
        The MCU can transmit data through MOSI and MISO line. 
config SPI_QUAD_MODE
    bool "Quad SPI"
    depends on SLAVE_ESP32_SERIES
    help
        Quad SPI goes beyond dual SPI, adding two more I/O lines and sends 4 data bits per clock cycle.
endchoice

choice SPI_DATA_TRANSMIT
    prompt "Data communicate way for SPI transmit"
    default SPI_STREAM_MODE

config SPI_STREAM_MODE
    bool "Stream mode"
    help
        Data can be assemble. The actual length sent by SPI may not be specified
config SPI_PACKET_MODE
    bool "Packet mode"
    help
        The SPI must be sent and received at a requested length.
endchoice

menu "spi gpio settings"
    depends on TRANSMIT_USE_SPI
    config SPI_SCLK_PIN
        int "SPI sclk pin"
        default 15
    config SPI_MOSI_PIN
        int "SPI mosi pin"
        default 13
    config SPI_MISO_PIN
        int "SPI miso pin"
        default 12
    config SPI_CS_PIN
        int "SPI cs pin"
        default 14
    config SPI_HANDSHAKE_PIN
        int "SPI handshake pin for slave send"
        default 5
    config SPI_WP_PIN
        int "SPI WP pin(quad spi)"
        default 16
        depends on SPI_QUAD_MODE
    config SPI_HD_PIN
        int "SPI HD pin(quad spi)"
        default 17
        depends on SPI_QUAD_MODE
endmenu

endmenu
```

## examples/customer/host/esp32/main/Kconfig.projbuild
```kconfig
menu "Example Configuration"

    config UART_ENABLE
        depends on !TINYUSB_CDC_ENABLED
        bool "Use Uart to Communication"
        default y
        help
            Enable Uart.

    config UART_PORT_NUM
        depends on UART_ENABLE
        int "UART port number"
        range 0 2 if IDF_TARGET_ESP32   || IDF_TARGET_ESP32S3
        range 0 1 if IDF_TARGET_ESP32S2 || IDF_TARGET_ESP32C3
        default 2 if IDF_TARGET_ESP32   || IDF_TARGET_ESP32S3
        default 1 if IDF_TARGET_ESP32S2 || IDF_TARGET_ESP32C3
        help
            UART communication port number for the example.
            See UART documentation for available port numbers.

    config UART_BAUD_RATE
        depends on UART_ENABLE
        int "UART communication speed"
        range 1200 115200
        default 115200
        help
            UART communication speed for Modbus example.

    config UART_RXD
        depends on UART_ENABLE
        int "UART RXD pin number"
        range 0 34 if IDF_TARGET_ESP32
        range 0 46 if IDF_TARGET_ESP32S2 || IDF_TARGET_ESP32S3
        range 0 19 if IDF_TARGET_ESP32C3
        default 19
        help
            GPIO number for UART RX pin. See UART documentation for more information
            about available pin numbers for UART.

    config UART_TXD
        depends on UART_ENABLE
        int "UART TXD pin number"
        range 0 34 if IDF_TARGET_ESP32
        range 0 46 if IDF_TARGET_ESP32S2 || IDF_TARGET_ESP32S3
        range 0 19 if IDF_TARGET_ESP32C3
        default 17
        help
            GPIO number for UART TX pin. See UART documentation for more information
            about available pin numbers for UART.

    config TASK_STACK_SIZE
        depends on UART_ENABLE
        int "UART echo example task stack size"
        range 1024 16384
        default 4096
        help
            Defines stack size for UART echo example. Insufficient stack size can cause crash.

endmenu # "Example Configuration"
menu "A2DP Example Configuration"

    choice EXAMPLE_A2DP_SINK_OUTPUT
        prompt "A2DP Sink Output"
        default EXAMPLE_A2DP_SINK_OUTPUT_EXTERNAL_I2S
        help
            Select to use Internal DAC or external I2S driver

        config EXAMPLE_A2DP_SINK_OUTPUT_INTERNAL_DAC
            bool "Internal DAC"
            help
                Select this to use Internal DAC sink output

        config EXAMPLE_A2DP_SINK_OUTPUT_EXTERNAL_I2S
            bool "External I2S Codec"
            help
                Select this to use External I2S sink output

    endchoice

    config EXAMPLE_I2S_LRCK_PIN
        int "I2S LRCK (WS) GPIO"
        default 18
        depends on EXAMPLE_A2DP_SINK_OUTPUT_EXTERNAL_I2S
        help
            GPIO number to use for I2S LRCK(WS) Driver.

    config EXAMPLE_I2S_BCK_PIN
        int "I2S BCK GPIO"
        default 26
        depends on EXAMPLE_A2DP_SINK_OUTPUT_EXTERNAL_I2S
        help
            GPIO number to use for I2S BCK Driver.

    config EXAMPLE_I2S_DATA_PIN
        int "I2S DATA GPIO"
        default 33
        depends on EXAMPLE_A2DP_SINK_OUTPUT_EXTERNAL_I2S
        help
            GPIO number to use for I2S Data Driver.
    config BT_A2DP_SINK_HCI
        bool "Enabe bt a2dp_sink feature"
        default y

endmenu
```

## examples/customer/host/esp32/sdkconfig.defaults
```kconfig
CONFIG_LWIP_L2_TO_L3_COPY=y
CONFIG_ESP32_DEFAULT_CPU_FREQ_240=y
CONFIG_ESP32_DEFAULT_CPU_FREQ_MHZ=240
CONFIG_MEMMAP_SMP=y

CONFIG_SYSTEM_EVENT_TASK_STACK_SIZE=4096

CONFIG_FREERTOS_UNICORE=y
CONFIG_FREERTOS_HZ=1000

CONFIG_INT_WDT=n
CONFIG_TASK_WDT=n

CONFIG_TCP_SND_BUF_DEFAULT=65534
CONFIG_TCP_WND_DEFAULT=65534
CONFIG_TCP_RECVMBOX_SIZE=64
CONFIG_UDP_RECVMBOX_SIZE=64
CONFIG_TCPIP_RECVMBOX_SIZE=64
CONFIG_LWIP_ETHARP_TRUST_IP_MAC=n

CONFIG_FLASHMODE_QIO=y
CONFIG_ESPTOOLPY_FLASHFREQ_80M=y
CONFIG_LWIP_IRAM_OPTIMIZATION=y

CONFIG_SPI_MASTER_IN_IRAM=y
CONFIG_SPI_MASTER_ISR_IN_IRAM=y
```
